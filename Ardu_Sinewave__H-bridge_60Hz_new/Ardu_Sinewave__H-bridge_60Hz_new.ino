#include <avr/io.h>
#include <avr/interrupt.h>


int lookUp1[] = {
  2000,
  2000,
  2000,2000,2000,
//  1810,
//  1715,
//  1621,
  1528,
  1437,
  1346,
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  2000,2000,2000,
//  1437,
//  1528,
//  1621,
//  1715,
  2000,2000,
  2000,
  2000,
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  2000,
  2000
};
int lookUp2[] = {
  2000,
  2000,
  2000,
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  2000,2000,
//  1715,
  2000,2000,2000,
//  1621,
//  1528,
//  1437,
  1346,
  1257,
  1169,
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  1346,
//  1437,
//  1528,
//  1621,
  2000,2000,2000,
//  1715,
//  1810,
  2000,2000,2000,
  2000
};


void setup() {
  // Register initilisation, see datasheet for more detail.
    TCCR1A = 0b10100010;
       /*10 clear on match, set at BOTTOM for compA.
         10 clear on match, set at BOTTOM for compB.
         00
         10 WGM1 1:0 for waveform 15.
       */
    TCCR1B = 0b00011001;
       /*000
         11 WGM1 3:2 for waveform 15.
         001 no prescale on the counter.
       */
    TIMSK1 = 0b00000001;
       /*0000000
         1 TOV1 Flag interrupt enable. 
       */
    ICR1   = 2000;     // Period for 16MHz crystal, for a switching frequency of 8KHz for 133 subdivisions per 60Hz sin wave cycle.
    sei();             // Enable global interrupts.
    DDRB = 0b00000110; // Set PB1 and PB2 as outputs.
    pinMode(8,OUTPUT);
    pinMode(12,OUTPUT);
    digitalWrite(12, 0);
    digitalWrite(8, 0);
}

void loop() {}


ISR(TIMER1_OVF_vect){
    static int num;
    
    // change duty-cycle every period.
    OCR1A = lookUp1[num];
    OCR1B = lookUp2[num];
    
    if(num == 1)   digitalWrite(8, 0);
    if(num == 68)  digitalWrite(8, 1);
    if(num == 70)  digitalWrite(12, 0);
    if(num == 132) digitalWrite(12, 1);;
    
    if(++num >= 133) num = 0;
    
}

